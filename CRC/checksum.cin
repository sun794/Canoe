/*@!Encoding:936*/
/*@!Encoding:936*/
//用于常用的CRC 等车身报文模拟发送
includes
{
 
}

variables
{
  word crc16;  
  byte data[13]; // 假设我们处理8字节的数据  
  word FlashCrc;
  word MasterAppCrc;
  word SlaverAppCrc;
  word TempCrc;
  word ALLCrc;
  /*CRC*/
  byte polynomial;        // 多项式
  dword CRC32_TABLE[256];
  dword CRC32_REVERSE = 0xEDB88320;
  byte Chksum_8bit_result=0;
  dword g_dwActualVerifyCrc32Code;
  word g_dwActualVerifyCrc16Code;
  byte g_dwActualVerifyCrc8Code;
  byte Check_Crc32_result[4]={0,0,0,0};
  byte Check_Crc16_result[2]={0,0};
  byte Crc16_only_result[0x100][2];
  byte Check_Crc8_result=0;
  
  byte Crc8Table[256] =
  {
    0x00, 0x1D, 0x3A, 0x27, 0x74, 0x69, 0x4E, 0x53,
    0xE8, 0xF5, 0xD2, 0xCF, 0x9C, 0x81, 0xA6, 0xBB,
    0xCD, 0xD0, 0xF7, 0xEA, 0xB9, 0xA4, 0x83, 0x9E,
    0x25, 0x38, 0x1F, 0x02, 0x51, 0x4C, 0x6B, 0x76,
    0x87, 0x9A, 0xBD, 0xA0, 0xF3, 0xEE, 0xC9, 0xD4,
    0x6F, 0x72, 0x55, 0x48, 0x1B, 0x06, 0x21, 0x3C,
    0x4A, 0x57, 0x70, 0x6D, 0x3E, 0x23, 0x04, 0x19,
    0xA2, 0xBF, 0x98, 0x85, 0xD6, 0xCB, 0xEC, 0xF1,
    0x13, 0x0E, 0x29, 0x34, 0x67, 0x7A, 0x5D, 0x40,
    0xFB, 0xE6, 0xC1, 0xDC, 0x8F, 0x92, 0xB5, 0xA8,
    0xDE, 0xC3, 0xE4, 0xF9, 0xAA, 0xB7, 0x90, 0x8D,
    0x36, 0x2B, 0x0C, 0x11, 0x42, 0x5F, 0x78, 0x65,
    0x94, 0x89, 0xAE, 0xB3, 0xE0, 0xFD, 0xDA, 0xC7,
    0x7C, 0x61, 0x46, 0x5B, 0x08, 0x15, 0x32, 0x2F,
    0x59, 0x44, 0x63, 0x7E, 0x2D, 0x30, 0x17, 0x0A,
    0xB1, 0xAC, 0x8B, 0x96, 0xC5, 0xD8, 0xFF, 0xE2,
    0x26, 0x3B, 0x1C, 0x01, 0x52, 0x4F, 0x68, 0x75,
    0xCE, 0xD3, 0xF4, 0xE9, 0xBA, 0xA7, 0x80, 0x9D,
    0xEB, 0xF6, 0xD1, 0xCC, 0x9F, 0x82, 0xA5, 0xB8,
    0x03, 0x1E, 0x39, 0x24, 0x77, 0x6A, 0x4D, 0x50,
    0xA1, 0xBC, 0x9B, 0x86, 0xD5, 0xC8, 0xEF, 0xF2,
    0x49, 0x54, 0x73, 0x6E, 0x3D, 0x20, 0x07, 0x1A,
    0x6C, 0x71, 0x56, 0x4B, 0x18, 0x05, 0x22, 0x3F,
    0x84, 0x99, 0xBE, 0xA3, 0xF0, 0xED, 0xCA, 0xD7,
    0x35, 0x28, 0x0F, 0x12, 0x41, 0x5C, 0x7B, 0x66,
    0xDD, 0xC0, 0xE7, 0xFA, 0xA9, 0xB4, 0x93, 0x8E,
    0xF8, 0xE5, 0xC2, 0xDF, 0x8C, 0x91, 0xB6, 0xAB,
    0x10, 0x0D, 0x2A, 0x37, 0x64, 0x79, 0x5E, 0x43,
    0xB2, 0xAF, 0x88, 0x95, 0xC6, 0xDB, 0xFC, 0xE1,
    0x5A, 0x47, 0x60, 0x7D, 0x2E, 0x33, 0x14, 0x09,
    0x7F, 0x62, 0x45, 0x58, 0x0B, 0x16, 0x31, 0x2C,
    0x97, 0x8A, 0xAD, 0xB0, 0xE3, 0xFE, 0xD9, 0xC4
  };
  
  word crctable[256] =
  {
    0x0000, 0x1021, 0x2042, 0x3063, 0x4084, 0x50A5, 0x60C6, 0x70E7,
    0x8108, 0x9129, 0xA14A,0xB16B,0xC18C,0xD1AD,0xE1CE,0xF1EF,
    0x1231, 0x0210, 0x3273, 0x2252, 0x52B5, 0x4294, 0x72F7, 0x62D6,
    0x9339, 0x8318, 0xB37B,0xA35A,0xD3BD,0xC39C,0xF3FF,0xE3DE,
    0x2462, 0x3443, 0x0420, 0x1401, 0x64E6, 0x74C7, 0x44A4, 0x5485,
    0xA56A,0xB54B, 0x8528, 0x9509,0xE5EE,0xF5CF,0xC5AC,0xD58D,
    0x3653, 0x2672, 0x1611, 0x0630, 0x76D7, 0x66F6, 0x5695, 0x46B4,
    0xB75B, 0xA77A, 0x9719, 0x8738,0xF7DF,0xE7FE,0xD79D,0xC7BC,
    0x48C4, 0x58E5, 0x6886, 0x78A7, 0x0840,0x1861, 0x2802, 0x3823,
    0xC9CC,0xD9ED,0xE98E,0xF9AF, 0x8948, 0x9969,0xA90A, 0xB92B,
    0x5AF5, 0x4AD4, 0x7AB7,0x6A96, 0x1A71, 0x0A50,0x3A33, 0x2A12,
    0xDBFD,0xCBDC,0xFBBF,0xEB9E,0x9B79, 0x8B58,0xBB3B,0xAB1A,
    0x6CA6, 0x7C87, 0x4CE4, 0x5CC5, 0x2C22, 0x3C03, 0x0C60, 0x1C41,
    0xEDAE,0xFD8F, 0xCDEC,0xDDCD,0xAD2A,0xBD0B,0x8D68, 0x9D49,
    0x7E97, 0x6EB6, 0x5ED5, 0x4EF4, 0x3E13, 0x2E32, 0x1E51, 0x0E70,
    0xFF9F, 0xEFBE, 0xDFDD,0xCFFC,0xBF1B,0xAF3A, 0x9F59, 0x8F78,
    0x9188, 0x81A9, 0xB1CA, 0xA1EB, 0xD10C, 0xC12D, 0xF14E,0xE16F,
    0x1080, 0x00A1, 0x30C2, 0x20E3, 0x5004, 0x4025, 0x7046, 0x6067,
    0x83B9, 0x9398, 0xA3FB,0xB3DA,0xC33D,0xD31C,0xE37F,0xF35E,
    0x02B1, 0x1290, 0x22F3, 0x32D2, 0x4235, 0x5214, 0x6277,0x7256,
    0xB5EA, 0xA5CB, 0x95A8,0x8589,0xF56E,0xE54F,0xD52C,0xC50D,
    0x34E2, 0x24C3, 0x14A0, 0x0481, 0x7466, 0x6447, 0x5424,0x4405,
    0xA7DB, 0xB7FA, 0x8799,0x97B8,0xE75F,0xF77E,0xC71D,0xD73C,
    0x26D3, 0x36F2, 0x0691, 0x16B0, 0x6657, 0x7676, 0x4615,0x5634,
    0xD94C, 0xC96D, 0xF90E,0xE92F,0x99C8,0x89E9,0xB98A,0xA9AB,
    0x5844, 0x4865, 0x7806, 0x6827, 0x18C0, 0x08E1, 0x3882,0x28A3,
    0xCB7D,0xDB5C,0xEB3F,0xFB1E,0x8BF9,0x9BD8,0xABBB,0xBB9A,
    0x4A75, 0x5A54, 0x6A37, 0x7A16,0x0AF1,0x1AD0,0x2AB3,0x3A92,
    0xFD2E,0xED0F,0xDD6C,0xCD4D,0xBDAA,0xAD8B,0x9DE8,0x8DC9,
    0x7C26, 0x6C07, 0x5C64,0x4C45,0x3CA2,0x2C83,0x1CE0,0x0CC1,
    0xEF1F,0xFF3E,0xCF5D,0xDF7C,0xAF9B,0xBFBA,0x8FD9,0x9FF8,
    0x6E17, 0x7E36, 0x4E55, 0x5E74, 0x2E93, 0x3EB2, 0x0ED1, 0x1EF0 
  };
  
  byte initCRC8Value = 0xFF;
  
  word awCRC16Table_CITT[256] = 
  {
    0x0000, 0x1021, 0x2042, 0x3063, 0x4084, 0x50A5, 0x60C6, 0x70E7,						
  	0x8108, 0x9129, 0xA14A, 0xB16B, 0xC18C, 0xD1AD, 0xE1CE, 0xF1EF,						
  	0x1231, 0x0210, 0x3273, 0x2252, 0x52B5, 0x4294, 0x72F7, 0x62D6,						
  	0x9339, 0x8318, 0xB37B, 0xA35A, 0xD3BD, 0xC39C, 0xF3FF, 0xE3DE,						
  	0x2462, 0x3443, 0x0420, 0x1401, 0x64E6, 0x74C7, 0x44A4, 0x5485,						
  	0xA56A, 0xB54B, 0x8528, 0x9509, 0xE5EE, 0xF5CF, 0xC5AC, 0xD58D,						
  	0x3653, 0x2672, 0x1611, 0x0630, 0x76D7, 0x66F6, 0x5695, 0x46B4,						
  	0xB75B, 0xA77A, 0x9719, 0x8738, 0xF7DF, 0xE7FE, 0xD79D, 0xC7BC,						
  	0x48C4, 0x58E5, 0x6886, 0x78A7, 0x0840, 0x1861, 0x2802, 0x3823,						
  	0xC9CC, 0xD9ED, 0xE98E, 0xF9AF, 0x8948, 0x9969, 0xA90A, 0xB92B,						
  	0x5AF5, 0x4AD4, 0x7AB7, 0x6A96, 0x1A71, 0x0A50, 0x3A33, 0x2A12,						
  	0xDBFD, 0xCBDC, 0xFBBF, 0xEB9E, 0x9B79, 0x8B58, 0xBB3B, 0xAB1A,						
  	0x6CA6, 0x7C87, 0x4CE4, 0x5CC5, 0x2C22, 0x3C03, 0x0C60, 0x1C41,						
  	0xEDAE, 0xFD8F, 0xCDEC, 0xDDCD, 0xAD2A, 0xBD0B, 0x8D68, 0x9D49,						
  	0x7E97, 0x6EB6, 0x5ED5, 0x4EF4, 0x3E13, 0x2E32, 0x1E51, 0x0E70,						
  	0xFF9F, 0xEFBE, 0xDFDD, 0xCFFC, 0xBF1B, 0xAF3A, 0x9F59, 0x8F78,						
  	0x9188, 0x81A9, 0xB1CA, 0xA1EB, 0xD10C, 0xC12D, 0xF14E, 0xE16F,						
  	0x1080, 0x00A1, 0x30C2, 0x20E3, 0x5004, 0x4025, 0x7046, 0x6067,						
  	0x83B9, 0x9398, 0xA3FB, 0xB3DA, 0xC33D, 0xD31C, 0xE37F, 0xF35E,						
  	0x02B1, 0x1290, 0x22F3, 0x32D2, 0x4235, 0x5214, 0x6277, 0x7256,						
  	0xB5EA, 0xA5CB, 0x95A8, 0x8589, 0xF56E, 0xE54F, 0xD52C, 0xC50D,						
  	0x34E2, 0x24C3, 0x14A0, 0x0481, 0x7466, 0x6447, 0x5424, 0x4405,						
  	0xA7DB, 0xB7FA, 0x8799, 0x97B8, 0xE75F, 0xF77E, 0xC71D, 0xD73C,						
  	0x26D3, 0x36F2, 0x0691, 0x16B0, 0x6657, 0x7676, 0x4615, 0x5634,						
  	0xD94C, 0xC96D, 0xF90E, 0xE92F, 0x99C8, 0x89E9, 0xB98A, 0xA9AB,						
  	0x5844, 0x4865, 0x7806, 0x6827, 0x18C0, 0x08E1, 0x3882, 0x28A3,						
  	0xCB7D, 0xDB5C, 0xEB3F, 0xFB1E, 0x8BF9, 0x9BD8, 0xABBB, 0xBB9A,						
  	0x4A75, 0x5A54, 0x6A37, 0x7A16, 0x0AF1, 0x1AD0, 0x2AB3, 0x3A92,						
  	0xFD2E, 0xED0F, 0xDD6C, 0xCD4D, 0xBDAA, 0xAD8B, 0x9DE8, 0x8DC9,						
  	0x7C26, 0x6C07, 0x5C64, 0x4C45, 0x3CA2, 0x2C83, 0x1CE0, 0x0CC1,						
  	0xEF1F, 0xFF3E, 0xCF5D, 0xDF7C, 0xAF9B, 0xBFBA, 0x8FD9, 0x9FF8,						
  	0x6E17, 0x7E36, 0x4E55, 0x5E74, 0x2E93, 0x3EB2, 0x0ED1, 0x1EF0						
  };
  
  dword gc_dwCRC16InitValue = 0xFFFF;
  
  dword TableCRC32[0x100] = 
  {
    0x00000000, 0x77073096, 0xEE0E612C, 0x990951BA,
    0x076DC419, 0x706AF48F, 0xE963A535, 0x9E6495A3,
    0x0EDB8832, 0x79DCB8A4, 0xE0D5E91E, 0x97D2D988,
    0x09B64C2B, 0x7EB17CBD, 0xE7B82D07, 0x90BF1D91,
    0x1DB71064, 0x6AB020F2, 0xF3B97148, 0x84BE41DE,
    0x1ADAD47D, 0x6DDDE4EB, 0xF4D4B551, 0x83D385C7,
    0x136C9856, 0x646BA8C0, 0xFD62F97A, 0x8A65C9EC,
    0x14015C4F, 0x63066CD9, 0xFA0F3D63, 0x8D080DF5,
    0x3B6E20C8, 0x4C69105E, 0xD56041E4, 0xA2677172,
    0x3C03E4D1, 0x4B04D447, 0xD20D85FD, 0xA50AB56B,
    0x35B5A8FA, 0x42B2986C, 0xDBBBC9D6, 0xACBCF940,
    0x32D86CE3, 0x45DF5C75, 0xDCD60DCF, 0xABD13D59,
    0x26D930AC, 0x51DE003A, 0xC8D75180, 0xBFD06116,
    0x21B4F4B5, 0x56B3C423, 0xCFBA9599, 0xB8BDA50F,
    0x2802B89E, 0x5F058808, 0xC60CD9B2, 0xB10BE924,
    0x2F6F7C87, 0x58684C11, 0xC1611DAB, 0xB6662D3D,
    0x76DC4190, 0x01DB7106, 0x98D220BC, 0xEFD5102A,
    0x71B18589, 0x06B6B51F, 0x9FBFE4A5, 0xE8B8D433,
    0x7807C9A2, 0x0F00F934, 0x9609A88E, 0xE10E9818,
    0x7F6A0DBB, 0x086D3D2D, 0x91646C97, 0xE6635C01,
    0x6B6B51F4, 0x1C6C6162, 0x856530D8, 0xF262004E,
    0x6C0695ED, 0x1B01A57B, 0x8208F4C1, 0xF50FC457,
    0x65B0D9C6, 0x12B7E950, 0x8BBEB8EA, 0xFCB9887C,
    0x62DD1DDF, 0x15DA2D49, 0x8CD37CF3, 0xFBD44C65,
    0x4DB26158, 0x3AB551CE, 0xA3BC0074, 0xD4BB30E2,
    0x4ADFA541, 0x3DD895D7, 0xA4D1C46D, 0xD3D6F4FB,
    0x4369E96A, 0x346ED9FC, 0xAD678846, 0xDA60B8D0,
    0x44042D73, 0x33031DE5, 0xAA0A4C5F, 0xDD0D7CC9,
    0x5005713C, 0x270241AA, 0xBE0B1010, 0xC90C2086,
    0x5768B525, 0x206F85B3, 0xB966D409, 0xCE61E49F,
    0x5EDEF90E, 0x29D9C998, 0xB0D09822, 0xC7D7A8B4,
    0x59B33D17, 0x2EB40D81, 0xB7BD5C3B, 0xC0BA6CAD,
    0xEDB88320, 0x9ABFB3B6, 0x03B6E20C, 0x74B1D29A,
    0xEAD54739, 0x9DD277AF, 0x04DB2615, 0x73DC1683,
    0xE3630B12, 0x94643B84, 0x0D6D6A3E, 0x7A6A5AA8,
    0xE40ECF0B, 0x9309FF9D, 0x0A00AE27, 0x7D079EB1,
    0xF00F9344, 0x8708A3D2, 0x1E01F268, 0x6906C2FE,
    0xF762575D, 0x806567CB, 0x196C3671, 0x6E6B06E7,
    0xFED41B76, 0x89D32BE0, 0x10DA7A5A, 0x67DD4ACC,
    0xF9B9DF6F, 0x8EBEEFF9, 0x17B7BE43, 0x60B08ED5,
    0xD6D6A3E8, 0xA1D1937E, 0x38D8C2C4, 0x4FDFF252,
    0xD1BB67F1, 0xA6BC5767, 0x3FB506DD, 0x48B2364B,
    0xD80D2BDA, 0xAF0A1B4C, 0x36034AF6, 0x41047A60,
    0xDF60EFC3, 0xA867DF55, 0x316E8EEF, 0x4669BE79,
    0xCB61B38C, 0xBC66831A, 0x256FD2A0, 0x5268E236,
    0xCC0C7795, 0xBB0B4703, 0x220216B9, 0x5505262F,
    0xC5BA3BBE, 0xB2BD0B28, 0x2BB45A92, 0x5CB36A04,
    0xC2D7FFA7, 0xB5D0CF31, 0x2CD99E8B, 0x5BDEAE1D,
    0x9B64C2B0, 0xEC63F226, 0x756AA39C, 0x026D930A,
    0x9C0906A9, 0xEB0E363F, 0x72076785, 0x05005713,
    0x95BF4A82, 0xE2B87A14, 0x7BB12BAE, 0x0CB61B38,
    0x92D28E9B, 0xE5D5BE0D, 0x7CDCEFB7, 0x0BDBDF21,
    0x86D3D2D4, 0xF1D4E242, 0x68DDB3F8, 0x1FDA836E,
    0x81BE16CD, 0xF6B9265B, 0x6FB077E1, 0x18B74777,
    0x88085AE6, 0xFF0F6A70, 0x66063BCA, 0x11010B5C,
    0x8F659EFF, 0xF862AE69, 0x616BFFD3, 0x166CCF45,
    0xA00AE278, 0xD70DD2EE, 0x4E048354, 0x3903B3C2,
    0xA7672661, 0xD06016F7, 0x4969474D, 0x3E6E77DB,
    0xAED16A4A, 0xD9D65ADC, 0x40DF0B66, 0x37D83BF0,
    0xA9BCAE53, 0xDEBB9EC5, 0x47B2CF7F, 0x30B5FFE9,
    0xBDBDF21C, 0xCABAC28A, 0x53B39330, 0x24B4A3A6,
    0xBAD03605, 0xCDD70693, 0x54DE5729, 0x23D967BF,
    0xB3667A2E, 0xC4614AB8, 0x5D681B02, 0x2A6F2B94,
    0xB40BBE37, 0xC30C8EA1, 0x5A05DF1B, 0x2D02EF8D
  };
  
  dword gc_dwCRC32InitValue = 0xFFFFFFFF;  
}


dword ssh_crc32(byte pdata[], dword dSize_u32,dword oldcrc)
{
  dword i;
  
  for (i = 0; i < dSize_u32; i++)
  {
    oldcrc = TableCRC32[(oldcrc ^ pdata[i]) & 0xff] ^ (oldcrc >> 8);
  }
  return oldcrc;
}

dword ssh_crc32_only(byte pdata[], dword dSize_u32)
{
  dword i, crc32;
  crc32=gc_dwCRC32InitValue;
  
  for (i = 0; i < dSize_u32; i++)
  {
    crc32 = TableCRC32[(crc32 ^ pdata[i]) & 0xff] ^ (crc32 >> 8);
  }
    return crc32;
}

 
dword ssh_crc16(byte pdata[], dword dSize_u16,word oldcrc) //这种是每包的CRC用于下一包计算
{
  long i;
  word tmp;
 
  for (i = 0; i < dSize_u16; i++)
  {
    tmp =(oldcrc>>8)^pdata[i];
    oldcrc=(oldcrc<<8)^awCRC16Table_CITT[tmp];
  }
  //write("oldcrc=0x%x",oldcrc);
  return oldcrc;
}


dword ssh_crc16_only(byte pdata[], dword dSize_u16)  //用固定CRC去计算当前的CRC
{
  long i;
  int tmp;
  word crc16;
  crc16= gc_dwCRC16InitValue;
  
for (i = 0; i < dSize_u16; i++)
  {
    tmp =(crc16>>8)^pdata[i];
    crc16=(crc16<<8)^awCRC16Table_CITT[tmp];
  }
  return crc16;
}


  
 byte ssh_crc8(byte data[],byte d_length,byte oldcrc)
 {
    int i;
 
    for (i = 0; i < d_length; i++)                     
    {
      oldcrc = Crc8Table[ oldcrc ^ data[i]];
    }  
     oldcrc = oldcrc^ 0xff;

    return  oldcrc;
  }

  byte ssh_crc8_only(byte data[],byte d_length)
{
    int i;
    byte crc8;
     
    crc8 =initCRC8Value ; // crc 计算的初始值
   
    for (i = 0; i < d_length; i++)                     
    {
        crc8 = Crc8Table[crc8 ^ data[i]];
    }  
    crc8 = crc8 ^ 0xff;

    return crc8;
}


//用于奇瑞项目的应用报文CRC校验 
//SAE J1850 CRC-8 是一种常用于汽车通信协议的循环冗余校验（CRC）算法
//以下多项式固定为polynomial = 0x1D  # SAE J1850 使用的多项式 0x1D
byte J1850_CRC8_cheery(byte buffer[], byte length)
{
  byte checksum,i,j;
  byte CRC8_Poly = 0x1D;
  checksum = 0x00;
  CRC8_Poly = 0x1D;
  
  for(i=0; i<length; i++)
  {
    checksum = checksum ^ buffer[i];

    for( j=0; j<8; j++ )
    {
      if(checksum & 0x80)
      {
        checksum = ((checksum << 1) ^ CRC8_Poly);  // POLY = 0x2F
      }
      else
      {
        checksum = (checksum << 1);
      }
    }
  }
  checksum = checksum ^ 0x00;
  return checksum;
}

//用于奇瑞捷途项目的应用报文CRC校验 
//SAE J1850 CRC-8 是一种常用于汽车通信协议的循环冗余校验（CRC）算法
//以下多项式固定为可输入的变量
//byte J1850_CRC8_Poly_cheery(byte buffer[], byte length, byte CRC8_Poly)
//{
//  
// byte checksum,i,j;
// //byte CRC8_Poly = 0x1D;
//  checksum = 0xFF;
////  CRC8_Poly = 0x1D;
//  for(i=0; i<length; i++)
//  {
//    checksum = checksum ^ buffer[i];
//
//    for( j=0; j<8; j++ )
//    {
//      if(checksum & 0x80)
//      {
//        checksum = ((checksum << 1) ^ CRC8_Poly);  // POLY = 0x2F
//      }
//      else
//      {
//        checksum = (checksum << 1);
//      }
//    }
//  }
//  checksum = checksum ^ 0xFF;
//  return checksum;
//}

//用于奇瑞捷途D01项目的应用报文CRC校验 
//SAE J1850 CRC-8 是一种常用于汽车通信协议的循环冗余校验（CRC）算法
//以下多项式固定为可输入的变量
byte J1850_CRC8_Poly_cheery(byte buffer[], byte length, byte CRC8_Poly)
{
  byte checksum,i,j;
 //byte CRC8_Poly = 0x1D;
  checksum = 0x00;
 //CRC8_Poly = 0x1D;
  for(i=0; i<length; i++)
  {
    checksum = checksum ^ buffer[i];

    for( j=0; j<8; j++ )
    {
      if(checksum & 0x80)
      {
        checksum = ((checksum << 1) ^ CRC8_Poly);  // POLY = 0x2F
      }
      else
      {
        checksum = (checksum << 1);
      }
    }
  }
  checksum = checksum ^ 0x00;
  return checksum;
}


byte E2E_CRC8_Table(byte data[],byte d_length,byte initial_value)
{
  int i;
  byte crc8;
  
  // crc8 = initial_value; // crc 计算的初始值
  crc8 = 0xff; // crc 计算的初始值
  
  for (i = 1; i < d_length + 1; i++)                     
  {
    crc8 = Crc8Table[crc8 ^ data[i]];
  }  
  crc8 = crc8 ^ 0xff;
  return crc8;
}

//
byte E2E_CRC8_Table_0(byte data[],byte d_length,byte initial_value)
{
  int i;
  byte crc8;
  
  // crc8 = initial_value; // crc 计算的初始值
  crc8 = 0xff; // crc 计算的初始值
  
  for (i = 0; i < d_length ; i++)                     
  {
    crc8 = Crc8Table[crc8 ^ data[i]];
  }  
  crc8 = crc8 ^ 0x00;
  return crc8;
}

// 适用于ox3B 报文，data 长度为64byte,CRC数据在中间24位置处
byte E2E_CRC8_Table_3B(byte data[],byte d_length,byte initial_value)
{
  int i;
  byte crc8;
  
  // crc8 = initial_value; // crc 计算的初始值
  crc8 = 0xff; // crc 计算的初始值
   
  for (i = 0; i < 24; i++)                     
  {
    crc8 = Crc8Table[crc8 ^ data[i]];
  } 
  
  for (i = 25; i < d_length + 1; i++)                     
  {
    crc8 = Crc8Table[crc8 ^ data[i]];
  } 
  crc8 = crc8 ^ 0xff;
  return crc8;
}


on key 'a'
{
  byte data[7] = {0x0A, 0x00, 0x00, 0x00, 0x00, 0x1F, 0x00};
  byte CRC[1] = 0;
  
  CRC[0] = J1850_CRC8_Poly_cheery(data,7,0x1d);
  write("I will reset the current counter is %x",CRC[0]);
}


 
word ssh_crc16_cheery(byte buffer[], byte length)
{
  word wCRCin;
  word wCPoly=0x1021;
  dword i,j;
  byte wChar = 0; 
  j=0;
  wCRCin=gc_dwCRC16InitValue;
  
  while(length--) 
  {
    wChar =buffer[j++]; 
    wCRCin ^= (wChar << 8); 
    for(i = 0; i < 8; i++) 
    { 
      if(wCRCin & 0x8000) 
      { 
        wCRCin = (wCRCin << 1) ^ wCPoly; 
      } 
      else 
      { 
        wCRCin = wCRCin << 1; 
      } 
    } 
  }
  wCRCin=wCRCin ^ 0x0000;
  return wCRCin;
}


word calculateCRC16(byte data[], int length)
{
  word crc = 0xFFFF; // 初始值
  int i, j;
  for (i = 0; i < length; i++)
  {
    crc ^= (word)data[i] << 8;
    for (j = 0; j < 8; j++)
    {
      if (crc & 0x8000)
        crc = (crc << 1) ^ 0x1021;
      else
      crc = crc << 1;
    }
  }
  // 输入取反
  crc ^= 0xFFFF;
  return crc;
}

// 计算CRC的函数
word calculateInvertedCRC16(byte data[], int length)
{
  // 对输入数据进行取反操作
  // byte invertedData[length];
  int i;
  word crc;
  for (i = 0; i < length; i++)
  {
    data[i] = ~data[i];
  }

  // 计算CRC
  crc = calculateCRC16(data, 13);
  // 对输出进行取反
  crc ^= 0xFFFF;
  
  return crc;
}


on start
{

  
}

on key *
{
  int i;
  byte data[13]= {0x00 ,0x10 ,0x00 ,0x00 ,0x00 ,0x03 ,0x06 ,0x05 ,0x00 ,0x78 ,0x05 ,0x88 ,0x13 };  // 设置电压14V  00 10 00 00 00 03 06 05 00 78 05 88 13
    // 对输入数据进行取反操作  
  for (i = 0; i < 13; i++) 
  {
    data[i] = ~data[i];  
  }  
    // 初始化数据 
 //byte data[13]={0x00 ,0x10 ,0x00 ,0x00 ,0x00 ,0x03 ,0x06 ,0x05 ,0x00 ,0x78 ,0x05 ,0x88 ,0x13 }; 
 
  crc16 = crc16bend_table_reflect(data,13);  
  // 对CRC结果进行取反操作  
  crc16 = ~crc16; 
  write("CRC16: 0x%X", crc16);  
}

void crc32b_init(void)
{
  long bytee;
  dword crc;
  byte bit;
  for ( bytee = 0; bytee < 256; bytee++)
  {
    crc = (dword)bytee; // reflected form
    
    for ( bit = 0; bit < 8; bit++)
      if (crc & 1)
        crc = (crc >> 1) ^ CRC32_REVERSE; // reflected Form
      else
      crc = (crc >> 1);
      
      CRC32_TABLE[bytee] = crc;
  }
    //write("CRC32_TABLE=%d=%d=%d",CRC32_TABLE[0],CRC32_TABLE[125],CRC32_TABLE[255]); 
}

dword crc32b_table_reflect(dword nLength, byte pData[])
{
  dword i;
  dword crc ; // Optimization: crc = CRC32_INIT;
  
  crc=-1;
  
  //write("crc=%d",crc);
  for(i=0;i<nLength;i++)
  {
    //write("pData=%d",pData[i]);
    crc = CRC32_TABLE[(crc ^ pData[i]) & 0xFF] ^ (crc >> 8);
       
  }
  
//while (nLength-- > 0)
//crc = CRC32_TABLE[(crc ^ *pData++) & 0xFF] ^ (crc >> 8); // reflect: >> 8
  
  return ~crc; // Optimization: crc ^= CRC32_DONE
}

byte crc8b_table_reflect(dword nLength, byte pData[])
{
  int tmp = 0x00;
  dword i;
  byte crc = 0x00;
  
  for(i=0;i<nLength;i=i+1)
  {
    tmp = tmp+pData[i];
  }
  crc = ~((byte)tmp);
  
  return crc;
}


word crc16b_table_reflect( word inicrc,dword nLength, byte pData[])
{
  dword i;
  int tmp;
  word crc ; // Optimization: crc = CRC32_INIT;
  crc = inicrc;
  //write("crc=%d",crc);
  
  for(i=0;i<nLength;i++)
  {
    //write("pData=%d",pData[i]);
    tmp = (crc>>8)^pData[i];
    crc = (crc<<8)^crctable[tmp];  
  }

//while (nLength-- > 0)
//crc = CRC32_TABLE[(crc ^ *pData++) & 0xFF] ^ (crc >> 8); // reflect: >> 8
  
  return crc; // Optimization: crc ^= CRC32_DONE
}

word crc16bstart_table_reflect(dword nLength, byte pData[])
{
  dword i;
  int tmp;
  word crc ; // Optimization: crc = CRC32_INIT; 
  crc = FlashCrc;
  //write("crc=%d",crc);
  for(i=0;i<nLength;i++)
  {
    //write("pData=%d",pData[i]);
    tmp = (crc>>8)^pData[i];
    crc = (crc<<8)^crctable[tmp];    
  }

//while (nLength-- > 0)
// crc = CRC32_TABLE[(crc ^ *pData++) & 0xFF] ^ (crc >> 8); // reflect: >> 8
  
  return crc; // Optimization: crc ^= CRC32_DONE
}


word crc16bend_table_reflect( byte data[],int length)
{
  int i;
  word crc = 0xFFFF; // 初始值，可以根据需要调整  
  
  for ( i = 0; i < length; i++) {  
  // 使用查找表并更新CRC值  
    crc = (crc << 8) ^ crctable[((crc >> 8) ^ data[i]) & 0xFF];  
  }
  
  return crc; // Optimization: crc ^= CRC32_DONE
}

//
//以下部分实现counter 进行0~15( 0-0X0F)的累加
byte E2E_Counter_0_F(byte data[],byte c_pos)
{
  // calculate counter
  int Counter;       
  Counter = data[c_pos] & 0x0F;
  Counter++;
  if(Counter > 15)
    Counter = Counter - 16;
  
  Counter = (data[c_pos] & 0xF0)+ Counter;
  return  Counter;
}


//以下部分实现counter 进行0~14的累加 
byte E2E_Counter_0_E(byte data[],byte c_pos)
{
  // calculate counter
  int Counter;       
  Counter = data[c_pos] & 0x0F;
  Counter++;
  if(Counter > 14)
    Counter = Counter - 15;
  
  Counter = (data[c_pos] & 0xF0)+ Counter;
  return  Counter;
}

//定义checksum 函数
//以下函数是实现针对7byte 处理
// ((Byte0+Byte1+….+Byte6) AND 0xFF) XOR 0xFF
word checksum_sum_7B(byte data[])
{
  byte get_data[7];
  word checksum_sum_7B_result = 0;
  int i=0;
	for(i=0;i< 7;i++)
  {
    get_data[i] = data[i];
  }
  
  checksum_sum_7B_result = (((get_data[0 ] + get_data[1 ]  + get_data[2 ]  + get_data[3 ]  + get_data[ 4]  + get_data[ 5] + get_data[ 6] )&0xff) ^ 0xff);
  //write ("the checksum is %lx",result);
  
  return checksum_sum_7B_result;
}
