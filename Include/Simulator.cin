/*@!Encoding:936*/
// 2023.12.1
//  wmg
// 报文仿真器，用于指定报文的仿真
/*
  使用方法：
  1.startSimulator 启动仿真器
  2.通过函数添加或删除仿真报文
    addSimulateMsg, removeSimulateMsg
  3.通过函数使能和禁用仿真报文
    enableSimulateMsg
    disableSimulateMsg
    enableAllSimulateMsg
    disableAllSimulateMsg
  4.通过函数重置仿真器（此时仿真器的定时器没有停止，只是把数据清空）。
    resetSimulator
  5.停止仿真器
    stopSimulator

*/

variables
{
  msTimer gSimulateTimer;
  
  const byte gMaxSimuateMsgNumber = 100;
  message* gSimulateMsgArray [gMaxSimuateMsgNumber];
  word gSimulateMsgCounter = 0;
  
    
  struct SimulateMsgInfoStruct
  {
    word interval;  //周期
    byte enable;    //使能
    int counter;    //计数器
  };
  long gSimulateValuePair_Id_Index[long];                               //  通过报文ID查找数组索引
  struct SimulateMsgInfoStruct gSimulateValuePair_Index_Msg[long];      //  通过数组索引存储仿真报文信息   
 
}

void startSimulator()
{
  setTimerCyclic(gSimulateTimer, 10);
  write("启动仿真器！");
}

void stopSimulator()
{
  cancelTimer(gSimulateTimer);
  write("停止仿真器！");
}

//添加仿真报文，周期，仿真报文的仿真使能（0禁用，1使能）
void addSimulateMsg(message* msg, word interval, byte simulateEnable)
{
  int i;
  int counter;
  counter = gSimulateMsgCounter;
  if(gSimulateValuePair_Id_Index.containsKey(msg.id))
  {
    write("ID=0x%X的报文已存在，添加仿真报文失败！");
    return;
  }
  for(i=0;i<gMaxSimuateMsgNumber;i++)
  {
    if(!gSimulateValuePair_Index_Msg.containsKey(i))
    {
      gSimulateValuePair_Id_Index[msg.id] = i;                      //通过ID分配索引
      gSimulateValuePair_Index_Msg[i].interval = interval;          //使能对应索引的message
      gSimulateValuePair_Index_Msg[i].counter = 0;                  // 计数器清零
      gSimulateValuePair_Index_Msg[i].enable = simulateEnable;      //使能对应索引的message
      
      gSimulateMsgArray[i] = msg;
      gSimulateMsgCounter++;
      break;
    }
  }
  if(counter == gSimulateMsgCounter)
  {
    write("仿真报文数组已满，添加仿真报文失败！");
  }
}

void removeSimulateMsg(dword id)
{
  int index;
  if(gSimulateValuePair_Id_Index.containsKey(id))
  {
    index = gSimulateValuePair_Id_Index[id];
    gSimulateValuePair_Index_Msg.remove(index);
    gSimulateValuePair_Id_Index.remove(id);
    gSimulateMsgCounter--;
    write("移除ID=0x%X的仿真报文！", id);
  }
  else
  {
    write("仿真报文数组中不存在ID=0x%X的报文！", id);
  }
}

void DisableSimulateMsg(dword id)
{
  int index;
  if(gSimulateValuePair_Id_Index.containsKey(id))
  {
    index = gSimulateValuePair_Id_Index[id];
    gSimulateValuePair_Index_Msg[index].enable = 0;
    write("禁用仿真ID=0x%X的仿真报文！", id);
  }
  else
  {
    write("仿真报文数组中不存在ID=0x%X的报文, 停发失败！", id);
  }
}

void enableSimulateMsg(dword id)
{
  int index;
  if(gSimulateValuePair_Id_Index.containsKey(id))
  {
    index = gSimulateValuePair_Id_Index[id];
    gSimulateValuePair_Index_Msg[index].enable = 1;
    write("使能仿真ID=0x%X的仿真报文！", id);
  }
  else
  {
    write("仿真报文数组中不存在ID=0x%X的报文, 发送失败！", id);
  }
}

void enableAllSimulateMsg()
{
  int i, msgCounter;
  msgCounter = 0;
  if(gSimulateMsgCounter < 1)
  {
    write("当前没有可以仿真的报文！");
    return;
  }
   write("使能仿真所有的仿真报文！");
  
  for(i=0;i<gMaxSimuateMsgNumber;i++)
  {
    if(gSimulateValuePair_Index_Msg.containsKey(i))
    {
      if(gSimulateValuePair_Index_Msg[i].enable == 0)
      {
        gSimulateValuePair_Index_Msg[i].enable = 1;
        write("启动仿真报文0x%X, 周期：%dms", gSimulateMsgArray[i].id, gSimulateValuePair_Index_Msg[i].interval);
      }
      if(++msgCounter >= gSimulateMsgCounter)
          break;
    }
  }
}

void disableAllSimulateMsg()
{
  int i, msgCounter;
  msgCounter = 0;
  if(gSimulateMsgCounter < 1)
  {
    write("当前没有可以仿真的报文！");
    return;
  }
  write("禁用仿真所有的仿真报文！");
  
  for(i=0;i<gMaxSimuateMsgNumber;i++)
  {
    if(gSimulateValuePair_Index_Msg.containsKey(i))
    {
      if(gSimulateValuePair_Index_Msg[i].enable == 1)
      {
        gSimulateValuePair_Index_Msg[i].enable = 0;
        write("禁用仿真报文0x%X", gSimulateMsgArray[i].id);
      }
      if(++msgCounter >= gSimulateMsgCounter)
          break;
    }
  }
}

void resetSimuator()
{
  gSimulateValuePair_Id_Index.clear();
  gSimulateValuePair_Index_Msg.clear();
  gSimulateMsgCounter = 0;
}

on timer gSimulateTimer
{
  int i;
  int msgCounter;
  msgCounter = 0;
  for(i=0;i<gMaxSimuateMsgNumber;i++)
  {
    if(gSimulateValuePair_Index_Msg.containsKey(i) && gSimulateValuePair_Index_Msg[i].enable)
    {
      gSimulateValuePair_Index_Msg[i].counter+=10;
      if(gSimulateValuePair_Index_Msg[i].counter >= gSimulateValuePair_Index_Msg[i].interval)
      {
        gSimulateValuePair_Index_Msg[i].counter = 0;
        output(gSimulateMsgArray[i]);
        if(++msgCounter >= gSimulateMsgCounter)
          break;
      }
    }
  }
}