/*@!Encoding:936*/
includes
{
  
}

variables
{
  int NeedCallBack=1;//0:不需要判断是否有应答 1：需要判断应答
  enum RelayType{
    DAM =0,
    QYF =1
  }RealType;
  const byte DevAddr=0xFE;//DAM和QG继电器的广播地址
  const byte PortNumber=0x06;//配置DAM和QG继电器的端口数量用于全开全断指令，当前默认设置为DAM2通道继电器，DAM：0x2 QG：0x6
  byte PowerPort ;//程控电源串口的端口号
  byte RelayPort;//继电器串口的端口号
  dword Baudrate=9600;//设置波特率
  const dword dataBits = 8;
  const dword stopBits = 1;
  const int kBUFFER_SIZE = 1000;
    // data is copied from callback buffer to gReceiverBuffer (collects data)
  byte gReceiverCallbackBuffer[kBUFFER_SIZE];
  byte gReceivedBuffer[kBUFFER_SIZE];
  byte gReceivedBuffertemp[kBUFFER_SIZE];
  dword gLastReceiveLength;
  const dword parity = 0;//0:none 1:even 0:odd
  const float POWER_VOLTAGE=12.0;
  const float POWER_CURRENT=5.0;
  const float POWER_OFF=0;
  byte gSeriIniTimes;
  byte gRelayIniTimes;//用于继电器串口的初始化通知打印
  float gVoltable[100];
  byte gVoltableLen;
  char gSerialReceivedData[50]="received serial data";
  char gSerialSendData[50]="Send serial data";
  msTimer remotemode;
  msTimer localmode;
  msTimer ClearError;
  byte aucCRCHi[256] = {
			0x00, 0xC1, 0x81, 0x40, 0x01, 0xC0, 0x80, 0x41, 0x01, 0xC0, 0x80, 0x41,
			0x00, 0xC1, 0x81, 0x40, 0x01, 0xC0, 0x80, 0x41, 0x00, 0xC1, 0x81, 0x40,
			0x00, 0xC1, 0x81, 0x40, 0x01, 0xC0, 0x80, 0x41, 0x01, 0xC0, 0x80, 0x41,
			0x00, 0xC1, 0x81, 0x40, 0x00, 0xC1, 0x81, 0x40, 0x01, 0xC0, 0x80, 0x41,
			0x00, 0xC1, 0x81, 0x40, 0x01, 0xC0, 0x80, 0x41, 0x01, 0xC0, 0x80, 0x41,
			0x00, 0xC1, 0x81, 0x40, 0x01, 0xC0, 0x80, 0x41, 0x00, 0xC1, 0x81, 0x40,
			0x00, 0xC1, 0x81, 0x40, 0x01, 0xC0, 0x80, 0x41, 0x00, 0xC1, 0x81, 0x40,
			0x01, 0xC0, 0x80, 0x41, 0x01, 0xC0, 0x80, 0x41, 0x00, 0xC1, 0x81, 0x40,
			0x00, 0xC1, 0x81, 0x40, 0x01, 0xC0, 0x80, 0x41, 0x01, 0xC0, 0x80, 0x41,
			0x00, 0xC1, 0x81, 0x40, 0x01, 0xC0, 0x80, 0x41, 0x00, 0xC1, 0x81, 0x40,
			0x00, 0xC1, 0x81, 0x40, 0x01, 0xC0, 0x80, 0x41, 0x01, 0xC0, 0x80, 0x41,
			0x00, 0xC1, 0x81, 0x40, 0x00, 0xC1, 0x81, 0x40, 0x01, 0xC0, 0x80, 0x41,
			0x00, 0xC1, 0x81, 0x40, 0x01, 0xC0, 0x80, 0x41, 0x01, 0xC0, 0x80, 0x41,
			0x00, 0xC1, 0x81, 0x40, 0x00, 0xC1, 0x81, 0x40, 0x01, 0xC0, 0x80, 0x41,
			0x01, 0xC0, 0x80, 0x41, 0x00, 0xC1, 0x81, 0x40, 0x01, 0xC0, 0x80, 0x41,
			0x00, 0xC1, 0x81, 0x40, 0x00, 0xC1, 0x81, 0x40, 0x01, 0xC0, 0x80, 0x41,
			0x00, 0xC1, 0x81, 0x40, 0x01, 0xC0, 0x80, 0x41, 0x01, 0xC0, 0x80, 0x41,
			0x00, 0xC1, 0x81, 0x40, 0x01, 0xC0, 0x80, 0x41, 0x00, 0xC1, 0x81, 0x40,
			0x00, 0xC1, 0x81, 0x40, 0x01, 0xC0, 0x80, 0x41, 0x01, 0xC0, 0x80, 0x41,
			0x00, 0xC1, 0x81, 0x40, 0x00, 0xC1, 0x81, 0x40, 0x01, 0xC0, 0x80, 0x41,
			0x00, 0xC1, 0x81, 0x40, 0x01, 0xC0, 0x80, 0x41, 0x01, 0xC0, 0x80, 0x41,
			0x00, 0xC1, 0x81, 0x40
	};
	
	byte aucCRCLo[256] = {
			0x00, 0xC0, 0xC1, 0x01, 0xC3, 0x03, 0x02, 0xC2, 0xC6, 0x06, 0x07, 0xC7,
			0x05, 0xC5, 0xC4, 0x04, 0xCC, 0x0C, 0x0D, 0xCD, 0x0F, 0xCF, 0xCE, 0x0E,
			0x0A, 0xCA, 0xCB, 0x0B, 0xC9, 0x09, 0x08, 0xC8, 0xD8, 0x18, 0x19, 0xD9,
			0x1B, 0xDB, 0xDA, 0x1A, 0x1E, 0xDE, 0xDF, 0x1F, 0xDD, 0x1D, 0x1C, 0xDC,
			0x14, 0xD4, 0xD5, 0x15, 0xD7, 0x17, 0x16, 0xD6, 0xD2, 0x12, 0x13, 0xD3,
			0x11, 0xD1, 0xD0, 0x10, 0xF0, 0x30, 0x31, 0xF1, 0x33, 0xF3, 0xF2, 0x32,
			0x36, 0xF6, 0xF7, 0x37, 0xF5, 0x35, 0x34, 0xF4, 0x3C, 0xFC, 0xFD, 0x3D,
			0xFF, 0x3F, 0x3E, 0xFE, 0xFA, 0x3A, 0x3B, 0xFB, 0x39, 0xF9, 0xF8, 0x38,
			0x28, 0xE8, 0xE9, 0x29, 0xEB, 0x2B, 0x2A, 0xEA, 0xEE, 0x2E, 0x2F, 0xEF,
			0x2D, 0xED, 0xEC, 0x2C, 0xE4, 0x24, 0x25, 0xE5, 0x27, 0xE7, 0xE6, 0x26,
			0x22, 0xE2, 0xE3, 0x23, 0xE1, 0x21, 0x20, 0xE0, 0xA0, 0x60, 0x61, 0xA1,
			0x63, 0xA3, 0xA2, 0x62, 0x66, 0xA6, 0xA7, 0x67, 0xA5, 0x65, 0x64, 0xA4,
			0x6C, 0xAC, 0xAD, 0x6D, 0xAF, 0x6F, 0x6E, 0xAE, 0xAA, 0x6A, 0x6B, 0xAB,
			0x69, 0xA9, 0xA8, 0x68, 0x78, 0xB8, 0xB9, 0x79, 0xBB, 0x7B, 0x7A, 0xBA,
			0xBE, 0x7E, 0x7F, 0xBF, 0x7D, 0xBD, 0xBC, 0x7C, 0xB4, 0x74, 0x75, 0xB5,
			0x77, 0xB7, 0xB6, 0x76, 0x72, 0xB2, 0xB3, 0x73, 0xB1, 0x71, 0x70, 0xB0,
			0x50, 0x90, 0x91, 0x51, 0x93, 0x53, 0x52, 0x92, 0x96, 0x56, 0x57, 0x97,
			0x55, 0x95, 0x94, 0x54, 0x9C, 0x5C, 0x5D, 0x9D, 0x5F, 0x9F, 0x9E, 0x5E,
			0x5A, 0x9A, 0x9B, 0x5B, 0x99, 0x59, 0x58, 0x98, 0x88, 0x48, 0x49, 0x89,
			0x4B, 0x8B, 0x8A, 0x4A, 0x4E, 0x8E, 0x8F, 0x4F, 0x8D, 0x4D, 0x4C, 0x8C,
			0x44, 0x84, 0x85, 0x45, 0x87, 0x47, 0x46, 0x86, 0x82, 0x42, 0x43, 0x83,
			0x41, 0x81, 0x80, 0x40
	};
  //Receive data for QYF 继电器
  byte QYFAllRespData[1]={0xEF};//QYF继电器单路断开指令的串口返回数据，跟控制所有端口开断的指令返回数据一致
  byte QYFSigleOpenRespData[2]={0xEF,0xFF};//QYF继电器单路连接指令的串口返回数据，跟其他指令返回数据不同的是有2个字节数据
  byte QYFSigleCloseRespData[1]={0xEF};//QYF继电器单路断开指令的串口返回数据，跟控制所有端口开断的指令返回数据一致
   //Receive data for DAM 继电器
  
  //QG继电器全开全断指令的串口返回数据跟DAM差不多，单路通断的串口返回数据跟发送的指令一致，QG对比DAM的继电器主要是端口数不一样，导致CRC16校验值也不一样，因此去掉后面校验码的比对后可以用用一个数组
  byte DAMAllRespData[6]={DevAddr,0x0F,0x00,0x00,0x00,PortNumber};
 
}

on timer remotemode
{
     
  if(DP_Send(PowerPort,"SYST:REM\r\n",10)==1)
    write("Into Remote mode!");
  else
    write("Fail To Into Remote mode!");
}

on timer localmode
{
 
  if(DP_Send(PowerPort,"SYST:LOC\r\n",10)==1)
  {
    write("Into Local mode!");
  }
  else
    write("Fail To Into Local mode!");
  }


on timer ClearError
{  
  
   if(DP_Send(PowerPort,"SYSTem:CLEar\r\n",14)==1)
      write("Clear Error!");
   else
      write("Fail To Clear Error!");
   
}


byte InitSerialPort(byte port)
 {
   
  // open the serial port (comes up with Windows defaults)
  if(rs232Open(port)!=1)
   {
 
    //write("An error occurred during opening of the serial port %d.",port);
    return 0;
  }
  if(rs232Configure(port,Baudrate,dataBits,stopBits,parity)!=1)
  {
   // write("An error occurred during initialization of the serial port %d.", port); 
    return 0;
  }
  #if 1
  // set buffer for reception (otherwise callback would not work)
  if(rs232Receive(port, gReceiverCallbackBuffer, kBUFFER_SIZE)!=1)//初始化的时候如果执行这句后续可以用rs232onReceive来接收串口回复的数据
  {  
   // write("An error occurred during setting the receiver buffer for serial Port %d.", port);
    return 0;
  }
  #endif
  
  return 1;
}

/// <rs232 Call back>
//这里注意CALLBACK的函数,RS一定要大写，可以看rs232Receive的使用说明的时候，关注这一细节
RS232OnReceive(dword port, byte buffer[], dword number) //这个是反馈接收节点，收到的串口数据是否正确//gReceiverCallbackBuffer  kBUFFER_SIZE参数
{
  dword i,j;
  if(number>0)//表示收到的串口回复数据长度不为0
  {
   gLastReceiveLength=number;//取每次收到的串口返回数据长度
   for(i=0;i<number;i++)
  {  
    gReceivedBuffer[i]=buffer[i];
   // write("%.0fms -> gReceivedBuffer[%d]:0x%02x",timeNowFloat()/100.0,i,gReceivedBuffer[i]);   
   }
  if(i>0)//加了个缓存的buffer,一定程度上可以解决串口数据同步的问题，但不是百分百，所以后续还是考虑只判断有无串口响应，不具体到字段有无错误
  {
    for(i=0;i<number;i++)
    {
      gReceivedBuffertemp[i]=gReceivedBuffer[i];
      if(gReceivedBuffertemp[i]>=0X7F &&gReceivedBuffertemp[i]<=0X20)
      {
       // write("RS232OnReceive %.0fms ->gReceivedBuffertemp[%d]:0x%02x",timeNowFloat()/100.0,i,gReceivedBuffertemp[i]);
      }
      else
      {
     // write("RS232OnReceive %.0fms ->gReceivedBuffertemp[%d]:%c",timeNowFloat()/100.0,i,gReceivedBuffertemp[i]); 
      }
     }
   }
  //testSupplyTextEvent(gSerialReceivedData);
  }
}
/// <rs232 Call back>
RS232OnSend(dword port, byte buffer[], dword number)
{
  long i;
  char string[256];//字符的类型
  byte SendByte[256];//字节的类型
  //testSupplyTextEvent(gSerialSendData);
  for(i=0; i<elcount(buffer); ++i)
  {
    SendByte[i] = buffer[i];
    if(SendByte[i]>=0x7F&&SendByte[i]<=0x20)//这个范围内不是单字节符或无法显示出来
    {
      // write("%.0fms -> 发送数据：SendData[%d]:0x%02X", timeNowfloat()/100.0,i,SendByte[i]);
    }
    else//这个范围内的字符是可以打印显示出来的
    {
     // write("%.0fms -> 发送数据：SendData[%d]:%c", timeNowfloat()/100.0,i,SendByte[i]); 
    }
  }
}
void InitNormalVoltage(byte port)
{
  gSeriIniTimes++;
  if(gSeriIniTimes==1)//每次测试循环只需要初始化一次
   {
     if(InitSerialPort(port)==1)
      {   
        //TeststepPass("","成功打开程控电源串口，端口号：[COM%d]",port);
        write("成功打开程控电源串口，端口号：[COM%d]!",port);
       }
      else
       { 
        //TeststepFail("","打开程控电源串口失败，端口号：[COM%d]",port);
       // write("打开程控电源串口失败，端口号：[COM%d]",port);
        return;
      }
    }
  if(DP_Send(port,"SYST:REM\r\n",10)==1)
   {
    ////Teststep("","远程控制程控电源成功!");
    write("远程控制程控电源成功!");
  }
  else
  {
    //Teststepfail("远程控制程控电源失败!");
    write("远程控制程控电源失败!");
    return;
  }
 DP_SetVoltage(12);
 if(DP_Send(port,"OUTP 1\r\n",8)==1)//输出电压
  {
    ////Teststep("","成功使能电压输出");
    write("成功使能电压输出");
  }
  else
  {
    //Teststepfail("","使能电压输出失败");
    write("使能电压输出失败");
  }
 
 //testWaitForTimeout(2000);
}
  
void RestorePowerSupplyLocalControl(byte port)
{
  gSeriIniTimes++;
  if(gSeriIniTimes==1)//每次测试循环只需要初始化一次
   {
     if(InitSerialPort(port)==1)
      {   
       // TeststepPass("","成功打开程控电源串口，端口号：[COM%d]",port);
        write("成功打开程控电源串口，端口号：[COM%d]",port);
       }
      else
       { 
        // TeststepFail("","打开程控电源串口失败，端口号：[COM%d]",port);
        write("打开程控电源串口失败，端口号：[COM%d]",port);
        return;
      }
   }
  DP_SetVoltage(POWER_OFF);
  if(DP_Send(port,"OUTP 0\r\n",8)==1)//关闭电压输出
  {
  //  ////Teststep("","关闭电源电压输出");
    write("关闭电源电压输出");
  }
  else
  {
   // //Teststepfail("","关闭电源电源输出失败");
    write("关闭电源电源输出失败");
  }
  
  
  if(DP_Send(port,"SYST:LOC\r\n",10)==1)
   {
   // //Teststep("","恢复成本地控制模式");
    write("恢复成本地控制模式");
  }
  else
  {
   // //Teststepfail("设置成本地控制模式失败");
    write("设置成本地控制模式失败");
    return;
  }
    
}

int InitRelayPortOpen(byte port,enum RelayType type) //目前我们使用的继电器DAM IO口最大到6 QYF最大到8
{
  int index = 0;
  int i;
  word crc;
  byte src[100];
  index =0;
  RealType=type;//继电器的类型 type 1:QYF  type 0 :DAM
  gRelayIniTimes++;
  RelayPort=port;
  if(gRelayIniTimes==1)//每次测试循环只需要初始化一次
   {
     if(InitSerialPort(port)==1)
      {   
      //  TeststepPass("","成功打开继电器串口，端口号：[COM%d]",port);
        write("成功打开继电器串口，端口号：[COM%d]",port);
       }
      else
       { 
        // TeststepFail("","打开继电器串口失败，端口号：[COM%d]",port);
         write("打开继电器串口失败，端口号：[COM%d]",port);
         return 0;
      }
  }
  if(RealType==DAM)
  {
  	src[index++] = DevAddr;
  	src[index++] = 0x0F;//ALL
  	src[index++] = 0x00;//起始地址高位
  	src[index++] = 0x00;//起始地址低位
  	src[index++] = 0x00;//控制继电器端口数量高位，一般这里默认为0，我们不需要使用那么多端口的继电器
  	src[index++] = PortNumber;//控制继电器端口数量低位，如果是青果的6路继电器，那么这里设置为06
    if(0<PortNumber&&PortNumber<=8)
    {  
      src[index++] = 0x01;//表示需要1个字节
      src[index++] = 0xFF;//闭合（每个bit表示一路继电器端口开闭，比如bit0=1,就是端口1闭合，因此一个字节表示8个端口）
      }
    else if(8<PortNumber&&PortNumber<=16)
    {
      src[index++] = 0x02; //表示需要2个字节
      src[index++] = 0xFF;//闭合
      src[index++] = 0xFF;//闭合
    }
    else if(16<PortNumber &&PortNumber<=24)
    {
      src[index++] = 0x03; //表示需要3个字节
      src[index++] = 0xFF;//闭合
      src[index++] = 0xFF;//闭合
      src[index++] = 0xFF;//闭合
    }
 
  	crc = usMBCRC16(src,index);
  	src[index++]  = crc&0xff;
  	src[index++]  = crc>>8;
    SendAndRead(port,src,index);
    write("11111111111111111111111111111");
    
   }
 
 else //QYF继电器指令的串口返回数据有点奇怪的点在于，第一次的请求，返回值都为0x00
   {
    src[index++] = 0x00;
    src[index++] = 0xf9;//连接全部端口
    src[index++] = 0xff;
    SendAndRead(port,src,index);
  
  }
  //testWaitForTimeout(1000);
  write("连接继电器所有端口成功");
 // testStep("","连接继电器所有端口成功");
  return 1;
}

int InitRelayPortClose(byte port,enum RelayType type) //目前我们使用的继电器DAM IO口最大到6 QYF最大到8
{
  int index = 0;
  int i;
  word crc;
  byte src[100];
  index =0;

  RealType=type;//继电器的类型 type 1:QYF  type 0 :DAM
  gRelayIniTimes++;
  RelayPort=port;
  if(gRelayIniTimes==1)//每次测试循环只需要初始化一次
   {
     if(InitSerialPort(port)==1)
      {   
        //TeststepPass("","成功打开继电器串口，端口号：[COM%d]",port);
        write("成功打开继电器串口，端口号：[COM%d]",port);
       }
      else
       { 
        // TeststepFail("","打开继电器串口失败，端口号：[COM%d]",port);
         write("打开继电器串口失败，端口号：[COM%d]",port);
         return 0;
      }
  }
  if(RealType==DAM)
  {
  	src[index++] = DevAddr;
  	src[index++] = 0x0F;//ALL
  	src[index++] = 0x00;
  	src[index++] = 0x00;
  	src[index++] = 0x00;
  	src[index++] = PortNumber;//端口数量，如果是青果的6路继电器，那么这里设置为06
   if(0<PortNumber&&PortNumber<=8)
    {  
      src[index++] = 0x01;//表示需要1个字节
      src[index++] = 0x00;//断开（每个bit表示一路继电器端口开闭，比如bit0=0,就是端口1断开，因此一个字节表示8个端口）
      }
    else if(8<PortNumber&&PortNumber<=16)
    {
      src[index++] = 0x02; //表示需要2个字节
      src[index++] = 0x00;//断开
      src[index++] = 0x00;//断开
    }
    else if(16<PortNumber &&PortNumber<=24)
    {
      src[index++] = 0x03; //表示需要3个字节
      src[index++] = 0x00;//断开
      src[index++] = 0x00;//断开
      src[index++] = 0x00;//断开
    }
   
  	crc = usMBCRC16(src,index);
  	src[index++]  = crc&0xff;
  	src[index++]  = crc>>8;
    SendAndRead(port,src,index);
  
   }
  else
   {
	  src[index++] = 0x00;
	  src[index++] = 0x09;//断开全部端口
	  src[index++] = 0xff;
    SendAndRead(port,src,index);
  
   }
  //testWaitForTimeout(1000);
  //teststep("","断开继电器所有端口成功");
  write("断开继电器所有端口成功");
  return 1;
}





byte DP_Send(byte port,char str[],byte len)
{
  byte buffer[100];
  byte i;
 
  for(i=0; i<len; i++)
  {
    buffer[i] = (byte)(str[i]);
  }
  
  if(0==rs232Send(port, buffer, len))
  {
    write("An error occurred during write of block of data to the serial Port %d.", port);
    return 0;
  } 
  
  return 1;
}
 
byte DP_SendByte(byte port,byte str[],byte len)
{
  byte i;
 
  
  if(0==rs232Send(port, str, len))
  {
    write("An error occurred during write of block of data to the serial Port %d.", port);
    return 0;
  } 

  return 1;
}
byte DP_SetVoltage(float data)//将设置电压和设置电流都模块化，只需要输入电压值就行
{
  char str[7]="VOLT ";
  char buf[100];
  word vol=0;
  byte i;
  float timetemp;
  for(i=0; i<5; i++)
  {
    buf[i]=str[i];
  }
  
  vol = (word)(data*100);//乘以100去掉小数点最后再换算回去，一般都是0.01的精度，所以小数点后面提取的时候就左移2位加上去
  
  if(vol>2400)//24V相当于是*100，单位是V
   {
    write("当前输入电压太高！");
    //testStepFail("当前输入电压太高！");
    return 0; 
      }
  else
  {
    buf[i++]=(byte)(vol/1000)+0x30;//这里是千位精度提取千位，因为是整形数除以它的精度就可以取最高位整  0x30其实表示的是0字符，其实可以不加
    vol%=1000;//提取百十位
    buf[i++]=(byte)(vol/100)+0x30;//这里是百位的精度，同上，对百位取整
    vol%=100;//提取十个位数
    buf[i++]='.';//字符.
    buf[i++]=(byte)(vol/10)+0x30;//十位数取精度，这个是取整
    buf[i++]=(byte)(vol%10)+0x30;//个位数取精度，这个是取剩下的余
    buf[i++]='\r';
    buf[i++]='\n';
    if(DP_Send(PowerPort,buf,i)!=1)
    {
      //testStepFail("","设置当前电压= %0.1fv 失败",data);
      write("设置当前电压:%0.1fv失败",data);
      return 0;
    }
    timetemp=timeNowFloat()/100000.0;
    //testStep("","设置当前电压= %0.1fv ，时间= %.0fms",data,timetemp);
    write("设置当前电压= %0.1fv，时间= %.0fs",data,timetemp);
   // putValue(Env_ReadVoltage,data);
  }
    return 1;
}
 
byte DP_GetVoltage()
{
  char str[12]="VOLTage?\r\n";
  char buf[100];
  byte i;
  float timetemp;
  for(i=0; i<10; i++)
  {
    buf[i]=str[i];
  }
  if(DP_Send(PowerPort,buf,i)!=1)
    {
      ////testStepFail("","读取当前电压失败");
      write("读取当前电压失败");
      return 0;
    }
    else
    {
     
    }
    return 1;
}
byte DP_SetCurrent(float data)
{
  char str[10]="CURR "; //设置最大电流
  char buf[100];
  word vol=0;
  float timetemp;
  byte i;
  
  for(i=0; i<5; i++)
  {
    buf[i]=str[i];
  }
  
  vol = (word)(data*1000);//这里是小数点右移三位，所以后面转换的时候要左移3位，因此在千位后就要加.
  
  if(vol>5000)
   { 
     write("当前输入限流值太大！");
     ////testStepFail("当前输入限流值太大！");
     return 0;
  }
  else
  {
    buf[i++]=(byte)(vol/1000)+0x30;//0x30为'0'字符，记住由浮点转换为整形字节数据发送串口端要+0x30，将串口端整形数据转换为浮点数的时候要-0x30,-之前要确保先转换为byte类型
    vol%=1000;
    buf[i++]='.';
    buf[i++]=(byte)(vol/100)+0x30;
    vol%=100;
    buf[i++]=(byte)(vol/10)+0x30;
    buf[i++]=(byte)(vol%10)+0x30;
    buf[i++]='\r';
    buf[i++]='\n';
 
 if(DP_Send(PowerPort,buf,i)!=1)//或者DP_send(buf,i);
  {
    ////testStepFail("","设置当前限流值= %.1fa失败",data);
    write("设置当前限流值= %.1fa失败",data);
    return 0;
  }
     //putValue(Env_ReadCurrent,data);
   // write("Current string:%s Length=%d",buf,i);//这里用strlen会有问题，除非手动补个'\0'
   timetemp=timeNowFloat()/100;
   //testStep("","设置当前限流值= :%0.1fa，时间= %.0fms",data,timetemp); 
   write("设置当前限流值= :%0.1fa，时间= %.0fms",data,timetemp);
  }
  return 1;
}
byte DP_GetCurrent()//这里无法读到当前实时电流，只能读取设置的额定电流上限
{
  char str[12]="CURRent?\r\n ";
  char buf[100];
  byte i;
  float timetemp;
  for(i=0; i<10; i++)
  {
    buf[i]=str[i];
  }
  if(DP_Send(PowerPort,buf,i)!=1)
    {
      //testStepFail("","读取当前电流失败");
      write("读取当前电流失败");
      return 0;
    }
    else
    {
     
    }
    return 1;
}
 
float AtoF(byte buffer[], dword len)//将串口byte信息转换为浮点数本质上就是getData+=float(buffer++);
{
  double getData;
  dword i;
  byte flag;
  dword per;
  
  getData = 0;//static
  per=1;//static
  flag=0;//static
  
  for(i=0; i<len; i++)
  {
    if('0'<=buffer[i] && buffer[i]<='9')//
    {
      getData*=10;//这里每循环增加一个字符，就进一位，直到遇到.
      getData+=(buffer[i]-0x30);//没有强制转换的话，通过2个值计算可以直接内部转换为优先级更高的浮点数                 //这个我认为理论上为float(buff[i]的算法) 一个通过计算一个利用功能直接强转换//这里-0x30实际上因为转换为byte后，需要减去'0'才能得到整形，举例，单字符'1'-'0'=1（十进制），然后浮点就看小数点在第几位了，这个处理比直接转换，数据容易失真好，如果一个浮点变成整形，那么将是直接去掉小数点后的值，而不是想x10的倍数后再变整形   ，如果一个整形变浮点数也是不能先移小数点，然后再转，一定先转了再除以倍数 
      if(flag)//1就执行自乘10倍
      {
        per*=10;//这里就是遇到小数点就开始处于10的n次方，这个算法是计算小数点的方式，第一次x10 再除以10等于增加一位但是没有进一，所以为小数点后，第二次x10小数点先右移一位，然后又除以100，左移2位，结果是比原来再多左移一位，即精度0.01，依次类推
      }                
    }
    else if(buffer[i]=='.')
    {
      flag=1;
    }   
  }
  
  getData/=per;//直到遇到了点，那么从点开始，后面每增加一个字符，从那个字符开始就缩小10倍，即小数点左移1位，2个就移2位，如a.bc=a+0.bc
 
  return getData;
}

word usMBCRC16(byte src[], int srclen)
{
  byte    ucCRCHi;
  byte    ucCRCLo;
  byte    iIndex;
  int i;
  i=0;//初始化一下
  iIndex=0;
  ucCRCHi = 0xFF;
  ucCRCLo = 0xFF;
	
   while ( srclen-- )
    {
        iIndex = ucCRCLo ^ src[i++];
        ucCRCLo =  ucCRCHi ^ aucCRCHi[iIndex];
        ucCRCHi = aucCRCLo[iIndex];
    }
    return(word)(ucCRCHi << 8 | ucCRCLo);
}



byte SendAndRead(byte port,byte src[],int srclen)
{
	byte n;
  DP_SendByte(port,src,srclen);
	//write("Sending %d bytes...",srclen);
	for(n=0;n<srclen;n++)
	{
	//	write("0x%02X ",src[n]);
	}

	return 1;
}
//控制继电器输出，导通 io:1为通道1';2为通道2
int OpenDO(int addr,int io,byte src[])
{
	int index;
  word crc;
  index =0;
	src[index++] = addr;
	src[index++] = 0x05;
	src[index++] = 0x00;
	src[index++] = io-1;//端口
	src[index++] = 0xff;//导通
	src[index++] = 0x00;
  

  crc = usMBCRC16(src,index);
	src[index++]  = crc&0xff;
	src[index++]  = crc>>8;
	return index;
}
int CloseDO(int addr,int io,byte src[])
{
	int index = 0;
  word crc;
  index =0;
	src[index++] = addr;
	src[index++] = 0x05;
	src[index++] = 0x00;
	src[index++] = io-1;//端口
	src[index++] = 0x00;//关闭
	src[index++] = 0x00;
  

	crc = usMBCRC16(src,index);
	src[index++]  = crc&0xff;
	src[index++]  = crc>>8;
	return index;
}
int ReadDO(int addr,int ionum,byte src[])//ionum指需要获取的DO口数目，不是序号
{
	int index;
  word crc;
  index=0;
	src[index++] = addr;
	src[index++] = 0x01;
	src[index++] = 0x00;
	src[index++] = 0x00;
	src[index++] = 0x00;
	src[index++] = ionum;

  crc = usMBCRC16(src,index);
	src[index++]  = crc&0xff;
	src[index++]  = crc>>8;
  if(ionum>6)
  {
    //teststep("","发送DAM继电器控制指令异常！");
    write("发送DAM继电器控制指令异常！");
		return 0;
  }
	return index;
}
int WriteDO(int addr,int info1,int info2,int info3,int info4,byte src[])
{
	int index;
  word crc ;
  index=0;
	src[index++] = addr;
	src[index++] = 0x0f;
	src[index++] = 0x00;
	src[index++] = 0x00;
	src[index++] = 0x00;
	src[index++] = 32;
	src[index++] = 4;
	src[index++] = info1;
	src[index++] = info2;
	src[index++] = info3;
	src[index++] = info4;

  crc= usMBCRC16(src,index);
	src[index++]  = crc&0xff;
	src[index++]  = crc>>8;
	return index;
}

  
int SetRelayOpen(byte portnum)//目前我们使用的DAM继电器IO口最大到6
{
	byte src[200];
  int index;
  float timetemp;
  int i;
	int srclen = 0;
  
  if(RealType==DAM)
  { 
  srclen  = OpenDO(DevAddr,portnum,src);
  if(portnum>6)
	{
    //teststepFail("","发送DAM继电器控制指令错误！");
		write("发送DAM继电器控制指令错误！");
		return 0;
	}
 
	SendAndRead(RelayPort,src,srclen);
  timetemp=timeNowFloat()/100;
 
  }
 else
 {  
  index=0;
  src[index++] = 0x00;
	src[index++] =0xF0 + (portnum & 0x0F);//连接端口
	src[index++] = 0xff;

  if(portnum>8)
	{
    ////teststepFail("","发送QYF继电器指令错误！");
		write("发送QYF继电器指令错误！");
		return 0;
	}

  SendAndRead(RelayPort,src,index);
 
   }
  //teststep("","继电器端口[%d]连接成功",portnum);
  //write("继电器端口[%d]连接成功",portnum);
	return 1;
}


int SetRelayClose(byte portnum)//目前我们使用的DAM继电器IO口最大到6
{
  
 
  int index;
  int i;
	byte src[200];
	int srclen = 0;

  if(RealType==DAM)
  {
   srclen = CloseDO(DevAddr,portnum,src);
  if(portnum>6)
	{
    ////teststepFail("","发送DAM继电器控制指令错误！");
		write("发送DAM继电器控制指令错误！");
		return 0;
	}
 
	SendAndRead(RelayPort,src,srclen);
  }
  else
  {
  index=0;
  src[index++] = 0x00;
	src[index++] = 0x0F & portnum;//断开端口
	src[index++] = 0xff;
  if(portnum>8)
	{
    ////teststepFail("","发送QYF继电器指令错误！");
		write("发送QYF继电器指令错误！");
		return 0;
	}
 
	SendAndRead(RelayPort,src,index);
 
 }
  //teststep("","继电器端口[%d]断开成功",portnum);
//  write("继电器端口[%d]断开成功",portnum);
	return 1;
}



