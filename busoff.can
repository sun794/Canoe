/*@!Encoding:936*/
includes
{
  
}

variables
{
  
}

on busoff  
{
  resetCanEx(this.can);
}
